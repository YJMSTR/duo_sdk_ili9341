/dts-v1/;
#include "cv180x_base_riscv.dtsi"
#include "cv180x_asic_qfn.dtsi"
#include "cv180x_asic_sd.dtsi"
#include "cv180x_default_memmap.dtsi"

&mipi_rx{
	snsr-reset = <&portc 8 GPIO_ACTIVE_LOW>, <&portc 8 GPIO_ACTIVE_LOW>, <&portc 8 GPIO_ACTIVE_LOW>;
};

/ {

};

&spi2 {
	status = "okay";
	/delete-node/ spidev@0;
	ili9341: ili9341@0{
		compatible = "adafruit,yx240qv29", "ilitek,ili9341";
		reg = <0>;
		status = "okay";
		spi-max-frequency = <32000000>;
		dc-gpios = <&porta 24 GPIO_ACTIVE_HIGH>;
		reset-gpios = <&porta 23 GPIO_ACTIVE_LOW>;
		rotate = <90>;
		spi-cpol;
		spi-cpha;
		fps = <30>;
		bgr;
		buswidth = <8>;
		// backlight = <$backlight>;
	};
};